## conf/bblayers.conf.sample
```bitbake
# POKY_BBLAYERS_CONF_VERSION is increased each time build/conf/bblayers.conf
# changes incompatibly
POKY_BBLAYERS_CONF_VERSION = "2"

BBPATH = "${TOPDIR}"
BBFILES ?= ""
BASE = "${TOPDIR}/../"

BBLAYERS ?= " \
  ${BASE}/poky/meta \
  ${BASE}/poky/meta-poky \
  ${BASE}/poky/meta-yocto-bsp \
  ${BASE}/meta-openembedded/meta-oe \
  ${BASE}/meta-openembedded/meta-multimedia \
  ${BASE}/meta-openembedded/meta-networking \
  ${BASE}/meta-openembedded/meta-python \
  ${BASE}/meta-raspberrypi \
  "
```
